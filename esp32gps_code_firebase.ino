#include <WiFi.h>
#include <Firebase_ESP_Client.h>
#include <TinyGPS++.h>

// Provide the token generation process info.
#include "addons/TokenHelper.h"
// Provide the RTDB payload printing info and other helper functions.
#include "addons/RTDBHelper.h"

// Network credentials
#define WIFI_SSID "wifiname"
#define WIFI_PASSWORD "wifipass"

// Firebase credentials for realtime database
#define API_KEY "apikey" 
#define USER_EMAIL "firebaseuseremail"
#define USER_PASSWORD "firebaseuseremail"
#define DATABASE_URL "databaseurl"

// Define Firebase objects
FirebaseData fbdo;
FirebaseAuth auth;
FirebaseConfig config;

// GPS settings
#define RXD2 16
#define TXD2 17
#define GPS_BAUD 9600

TinyGPSPlus gps;
HardwareSerial gpsSerial(2);

// Database main path
String uid;
String databasePath;
FirebaseJson json;

unsigned long sendDataPrevMillis = 0;
unsigned long timerDelay = 4000; // Send data every 4 secs

void initWiFi() {
  WiFi.begin(WIFI_SSID, WIFI_PASSWORD);
  Serial.print("Connecting to WiFi ..");
  while (WiFi.status() != WL_CONNECTED) {
    Serial.print('.');
    delay(1000);
  }
  Serial.println(WiFi.localIP());
  Serial.println();
}

void setup() {
  Serial.begin(115200);

  // Initialize WiFi and Firebase
  initWiFi();
  config.api_key = API_KEY;
  auth.user.email = USER_EMAIL;
  auth.user.password = USER_PASSWORD;
  config.database_url = DATABASE_URL;
  Firebase.reconnectWiFi(true);
  fbdo.setResponseSize(4096);
  config.token_status_callback = tokenStatusCallback;
  config.max_token_generation_retry = 5;
  Firebase.begin(&config, &auth);

  // Get the user UID
  Serial.println("Getting User UID");
  while ((auth.token.uid) == "") {
    Serial.print('.');
    delay(1000);
  }
  uid = auth.token.uid.c_str();
  Serial.print("User UID: ");
  Serial.println(uid);
  
  // Update database path
  databasePath = "/UsersData/" + uid + "/gps_readings";

  // Initialize GPS
  gpsSerial.begin(GPS_BAUD, SERIAL_8N1, RXD2, TXD2);
  Serial.println("GPS Serial started at 9600 baud rate");
}

void loop() {
  // Collect GPS data
  while (gpsSerial.available() > 0) {
    gps.encode(gpsSerial.read());
  }

  // Check if location is updated and ready to send to Firebase
  if (Firebase.ready() && (millis() - sendDataPrevMillis > timerDelay || sendDataPrevMillis == 0) && gps.location.isUpdated()) {
    sendDataPrevMillis = millis();

    // Get current data
    float latitude = gps.location.lat();
    float longitude = gps.location.lng();
    float speed = gps.speed.kmph();
    unsigned long timestamp = millis() / 1000;

    // Display in Serial Monitor
    Serial.print("LAT: ");
    Serial.println(latitude, 6);
    Serial.print("LONG: ");
    Serial.println(longitude, 6);
    Serial.print("SPEED (km/h): ");
    Serial.println(speed);
    Serial.print("TIME: ");
    Serial.println(timestamp);

    // Add data to Firebase
    json.set("/latitude", String(latitude, 6));
    json.set("/longitude", String(longitude, 6));
    json.set("/speed", String(speed));
    json.set("/timestamp", String(timestamp));

    // Push data to Firebase and retrieve unique key
    if (Firebase.RTDB.pushJSON(&fbdo, databasePath.c_str(), &json)) {
      String uniqueKey = fbdo.pushName(); // Retrieve the unique key generated by Firebase
      Serial.printf("Data added successfully with unique key: %s\n", uniqueKey.c_str());
    } else {
      Serial.printf("Failed to push data: %s\n", fbdo.errorReason().c_str());
    }
  }
}
